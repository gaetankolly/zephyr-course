## boards/custom_nucleo_f446re/board.yml
```yaml
board:
  name: custom_nucleo_f446re
  full_name: Custom board Nucleo F446RE
  vendor: st
  socs:
    - name: stm32f446xx
```

## boards/my_board/board.yml
```yaml
board:
  name: my_board
  full_name: My board from scratch
  vendor: Ga
  socs:
    - name: stm32f446xx
```

## boards/my_board/my_board_defconfig
```kconfig
CONFIG_SERIAL=y

# console
CONFIG_CONSOLE=y
CONFIG_UART_CONSOLE=y

#enable sensor 
CONFIG_SENSOR=y
```

## my_driver_module/drivers/my_driver/Kconfig
```kconfig
config MY_DRIVER
    bool "My custom driver"
    default y
    depends on DT_HAS_MY_DRIVER_ENABLED  # only if the dt has an enabled node
    depends on SENSOR

if MY_DRIVER

config MY_DRIVER_CNT_MIN
    int "Minimum counter value"
    default 0
    help
      Lowest value accepted by my_driver_set_cnt().

config MY_DRIVER_CNT_MAX
    int "Maximum counter value"
    default 100
    help
      Highest value accepted by my_driver_set_cnt().

endif
```

## my_driver_module/dts/bindings/my,driver.yaml
```yaml
description: Our custom sensor driver binding
compatible: "my,driver"

properties:
  led:                  # Reference to one child node of a "gpio-leds" node
    type: phandle       # Reference to another node
    required: true      # Build fails if the node doesn't set it
    description: LED (child of a gpio-leds node) driven by this sensor
```
