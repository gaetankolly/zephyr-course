## CMakeLists.txt
```
cmake_minimum_required(VERSION 3.20.0)

list(APPEND BOARD_ROOT "${CMAKE_CURRENT_LIST_DIR}/..")
list(APPEND ZEPHYR_EXTRA_MODULES "${CMAKE_CURRENT_LIST_DIR}/../my_driver_module")

find_package(Zephyr REQUIRED)
project(my_zephyr_app)

target_sources(app PRIVATE src/main.cpp)
```

## Kconfig
```
menuconfig LED_SUBSYSTEM
    bool "LED subsystem"

if LED_SUBSYSTEM
    choice 
        prompt "Led blinking speed"
        default BLINK_SLEEP_1000_MS

        config BLINK_SLEEP_250_MS
            bool "0.25s (fast)"
        
        config BLINK_SLEEP_1000_MS
            bool "1s (Medium)"

        config BLINK_SLEEP_2000_MS
            bool "2s (Slow)"
    endchoice

    config BLINK_SLEEP_TIME_MS
        int 
        default 250 if BLINK_SLEEP_250_MS
        default 1000 if BLINK_SLEEP_1000_MS
        default 2000 if BLINK_SLEEP_2000_MS
        help
            help string can be 
            multiple lines

    
    menuconfig ADVANCE_LED_SETTING
        bool "Advanced LED settings"

    if (ADVANCE_LED_SETTING)

        config LED_BRIGHTNESS
            int "LED brightness"
            range 0 100
            default 100

        config LED_FADE_DURATION
            int "LED fade duration (ms)"
            range 0 5000
            default 500

        menu "Expert setting"
            config LED_DEBUG_EN
                bool "Enable LED debugging"
            
            config LED_CUSTOM_BLINK
                bool "Custom blink pattern"

        endmenu


    endif # ADVANCE_LED_SETTING

        
endif # LED_SUBSYSTEM

source "Kconfig.zephyr"
```

## prj.conf
```kconfig
CONFIG_GPIO=y
CONFIG_LOG=y

CONFIG_SHELL=y
```

## src/main.cpp
```c
#include <zephyr/drivers/gpio.h>
#include <zephyr/drivers/sensor.h>
#include <zephyr/kernel.h>
#include <zephyr/logging/log.h>
#ifdef CONFIG_MY_DRIVER
#include <my_drivers/my_driver.h>
#endif


#ifdef CONFIG_MY_DRIVER
static const struct device *const sensor = DEVICE_DT_GET(DT_NODELABEL(my_sensor));
#else
/* The devicetree node identifier for the "led0" alias. */
#define LED_NODE DT_ALIAS(app_led)
static const struct gpio_dt_spec led = GPIO_DT_SPEC_GET(LED_NODE, gpios);
#endif


LOG_MODULE_REGISTER(main, LOG_LEVEL_INF);

int main(void)
{
    LOG_INF("Now we are in main()");
    bool led_state = true;

    #ifdef CONFIG_MY_DRIVER
    if (!device_is_ready(sensor)) return 0;

    my_driver_set_cnt(sensor, 5); 

    #ifndef CONFIG_SHELL
    bool toggle = 0;
    while (1) {
        if (toggle) {
            if (sensor_sample_fetch(sensor) < 0) {
                break;
            }
        } 
        else {
            sensor_value value;
            sensor_channel channel = static_cast<sensor_channel>(0);
            sensor_channel_get(sensor, channel, &value);
        }

        toggle = !toggle;
        k_msleep(CONFIG_APP_HEARTBEAT_PERIOD_MS);
    }
    #endif
    #else
    if (!gpio_is_ready_dt(&led)) return 0;

    if (gpio_pin_configure_dt(&led, GPIO_OUTPUT_ACTIVE) < 0) return 0;

    while (1) {
        if (gpio_pin_toggle_dt(&led) < 0) return 0;

        led_state = !led_state;
        // LOG_INF("LED state: %s", led_state ? "ON" : "OFF");
        k_msleep(CONFIG_APP_HEARTBEAT_PERIOD_MS);
    }
    #endif
    return 0;
}
```
